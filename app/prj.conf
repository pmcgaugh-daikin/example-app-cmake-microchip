## CMakeLists.txt
```
#-------------------------------------------------------------------------------
# Microchip Zephyr Example Application
#
# Copyright (c) 2023 Daikin Comfort Technologies North America, Inc.
# SPDX-License-Identifier: Apache-2.0

cmake_minimum_required(VERSION 3.13.1)

# To add new overlay or config files use the following commands
# set(OVERLAY_CONFIG "<YOUR FILE HERE>;${OVERLAY_CONFIG}" CACHE INTERNAL "" FORCE)
# set(DTC_OVERLAY_FILE "<YOUR FILE HERE>;${DTC_OVERLAY_FILE}" CACHE INTERNAL "" FORCE)

include("../scripts/zephyr_cmake_utils.cmake")

if("${CMAKE_BUILD_TYPE}" STREQUAL "Debug")
    message(AUTHOR_WARNING "WARNING: Debug build selected, debug.conf file is included")
    append_zephyr_config(confs_overlays/debug.conf)
endif()

if("${CONFIG_APP_MCUBOOT_BUILD}" STREQUAL "y")
    message(STATUS "Application MCUBOOT is enabled.")
    append_zephyr_config(confs_overlays/mcuboot.conf)
    append_zephyr_overlay(confs_overlays/atsame54_xpro_mcuboot_partitions.overlay)
    append_zephyr_overlay(confs_overlays/mcuboot.overlay)
endif()

if("${CONFIG_APP_THREAD_ANALYSER}" STREQUAL "y")
    append_zephyr_config(confs_overlays/thread_analysis.conf)
endif()

if("${CONFIG_APP_OPENTHREAD_BUILD}" STREQUAL "y")
    append_zephyr_config(confs_overlays/ot.conf)
    append_zephyr_overlay(confs_overlays/atsame54_xpro_openthread_partitions.overlay)
endif()

if("${CONFIG_APP_CDC_ACM_LOGGING}" STREQUAL "y")
    append_zephyr_config(confs_overlays/cdc_acm_uart.conf)
    append_zephyr_overlay(confs_overlays/cdc_acm_uart.overlay)
endif()


find_package(Zephyr REQUIRED HINTS $ENV{ZEPHYR_BASE})

project(app LANGUAGES C)

target_sources(app PRIVATE src/main.c src/usb_cdc_acm_logging.c)

get_cmake_property(_variableNames VARIABLES)
list(SORT _variableNames)

foreach(_variableName ${_variableNames})
    #message(STATUS "${_variableName}=${${_variableName}}")
endforeach()

set(VSCODE_SETTINGS_PATH "${CMAKE_CURRENT_SOURCE_DIR}/.vscode/cmake_cache.json")

if(EXISTS "${VSCODE_SETTINGS_PATH}")
    file(READ "${VSCODE_SETTINGS_PATH}" VSCODE_SETTINGS_JSON)
else()
    set(VSCODE_SETTINGS_JSON "{}")
endif()
    # foreach(_variableName ${_variableNames})
    # string(JSON VSCODE_SETTINGS_JSON_NEW SET ${VSCODE_SETTINGS_JSON} "${_variableName}" "\"${${_variableName}}\"")
    # string(JSON VSCODE_SETTINGS_JSON_NEW SET ${VSCODE_SETTINGS_JSON_NEW} "${_variableName}" "\"${${_variableName}}\"")

    # message(STATUS " ${_variableName}=${${_variableName}} ")
    # endforeach()
string(JSON VSCODE_SETTINGS_JSON_NEW SET ${VSCODE_SETTINGS_JSON} "BOARD_DIR" "\"${BOARD_DIR}\"")
string(JSON VSCODE_SETTINGS_JSON_NEW SET ${VSCODE_SETTINGS_JSON} "CONFIG_SOC_PART_NUMBER" "\"${CONFIG_SOC_PART_NUMBER}\"")
string(JSON VSCODE_SETTINGS_JSON_NEW SET ${VSCODE_SETTINGS_JSON} "SOC_SERIES" "\"${SOC_SERIES}\"")
string(JSON VSCODE_SETTINGS_JSON_NEW SET ${VSCODE_SETTINGS_JSON} "SOC_FAMILY" "\"${SOC_FAMILY}\"")
string(JSON VSCODE_SETTINGS_JSON_NEW SET ${VSCODE_SETTINGS_JSON} "ZEPHYR_SDK_INSTALL_DIR" "\"${ZEPHYR_SDK_INSTALL_DIR}\"")

# string(JSON VSCODE_SETTINGS_JSON_NEW SET ${VSCODE_SETTINGS_JSON_NEW} " your_var2" "whatever_value ")

# and so on ...
if(NOT "${VSCODE_SETTINGS_JSON_NEW}" STREQUAL "${VSCODE_SETTINGS_JSON} ")
    file(WRITE "${VSCODE_SETTINGS_PATH}" "${VSCODE_SETTINGS_JSON_NEW}")
endif()
```

## Kconfig
```
# Copyright (c) 2021 Nordic Semiconductor ASA
# SPDX-License-Identifier: Apache-2.0
#
# This file is the application Kconfig entry point. All application Kconfig
# options can be defined here or included via other application Kconfig files.
# You can browse these options using the west targets menuconfig (terminal) or
# guiconfig (GUI).

menu "Zephyr"
source "Kconfig.zephyr"
endmenu

module = APP
module-str = APP
source "subsys/logging/Kconfig.template.log_config"

config APP_MCUBOOT_BUILD
     bool "Enable mcuboot support for the application"
     depends on BOARD_ATSAME54_XPRO
     default n

config APP_OPENTHREAD_BUILD
     bool "Enable openthread support for the application"
     depends on BOARD_ATSAME54_XPRO
     default n

config APP_THREAD_ANALYSIS
     bool "Enable thread analysis logic in the application"
     default n

config APP_CDC_ACM_LOGGING
     bool "Enable USB CDC ACM logging support"
     default n
```

## sample.yaml
```
# This file is provided so that the application can be compiled using Twister,
# the Zephyr testing tool. In this file, multiple combinations can be specified,
# so that you can easily test all of them locally or in CI.
sample:
  description: Example application
  name: example-application 
common:
  build_only: true
  integration_platforms:
    - atsame54_xpro
tests:
  app.default: {}
  app.debug:
    extra_overlay_confs:
      - debug.conf
```

## prj.conf
```kconfig
# Copyright (c) 2021 Nordic Semiconductor ASA
# SPDX-License-Identifier: Apache-2.0
#
# This file contains selected Kconfig options for the application.

CONFIG_BOOT_BANNER=y
```

## src/main.c
```c
/*
 * Copyright (c) 2023 Daikin Comfort Technologies North America, Inc.
 * Copyright (c) 2021 Nordic Semiconductor ASA
 * SPDX-License-Identifier: Apache-2.0
 * 
 * This file has been modified by Daikin Comfort Technologies North America, Inc.
 *  - remove sensor references and add counter logging
 * 
 */

#include <zephyr/kernel.h>
#include <zephyr/drivers/gpio.h>
#include <app_version.h>

#include <zephyr/logging/log.h>
LOG_MODULE_REGISTER(main, CONFIG_APP_LOG_LEVEL);

#ifdef CONFIG_APP_CDC_ACM_LOGGING
#define USB_CDC_ACM_STACK_SIZE 500
#define USB_CDC_ACM_PRIORITY 5

extern void usb_cdc_acm_thread(void *, void *, void *);

K_THREAD_DEFINE(my_tid, USB_CDC_ACM_STACK_SIZE,
                usb_cdc_acm_thread, NULL, NULL, NULL,
                USB_CDC_ACM_PRIORITY, 0, 0);
#endif

int main(void)
{
    printk("Zephyr Example Application %s\n", APP_VERSION_STRING);

    static const struct gpio_dt_spec led0 = GPIO_DT_SPEC_GET(DT_ALIAS(led0), gpios);
    gpio_pin_configure_dt(&led0, GPIO_OUTPUT);

	while (1) {
        if (!gpio_is_ready_dt(&led0))
        {
            return 0;
        }

        static int cnt = 0;
        cnt++;
        LOG_INF("Current iteration: %d", cnt);
        
        gpio_pin_toggle(led0.port, led0.pin);

		k_sleep(K_MSEC(1000));
	}

	return 0;
}
```

## src/usb_cdc_acm_logging.c
```c
/*
 * Copyright (c) 2019 Intel Corporation
 *
 * SPDX-License-Identifier: Apache-2.0
 */

/**
 * @file
 * @brief Sample echo app for CDC ACM class
 *
 * Sample app for USB CDC ACM class driver. The received data is echoed back
 * to the serial port.
 */

#ifdef CONFIG_APP_CDC_ACM_LOGGING

#include <stdio.h>
#include <string.h>
#include <zephyr/device.h>
#include <zephyr/drivers/uart.h>
#include <zephyr/kernel.h>
#include <zephyr/sys/ring_buffer.h>

#include <zephyr/usb/usb_device.h>
#include <zephyr/usb/usbd.h>
#include <zephyr/logging/log.h>
LOG_MODULE_REGISTER(cdc_acm_echo, LOG_LEVEL_INF);

#define RING_BUF_SIZE 1024
uint8_t ring_buffer[RING_BUF_SIZE];

struct ring_buf ringbuf;

#if defined(CONFIG_USB_DEVICE_STACK_NEXT)
USBD_CONFIGURATION_DEFINE(config_1,
			  USB_SCD_SELF_POWERED,
			  200);

USBD_DESC_LANG_DEFINE(sample_lang);
USBD_DESC_MANUFACTURER_DEFINE(sample_mfr, "ZEPHYR");
USBD_DESC_PRODUCT_DEFINE(sample_product, "Zephyr USBD CDC ACM");
USBD_DESC_SERIAL_NUMBER_DEFINE(sample_sn, "0123456789ABCDEF");

USBD_DEVICE_DEFINE(sample_usbd,
		   DEVICE_DT_GET(DT_NODELABEL(zephyr_udc0)),
		   0x2fe3, 0x0001);

static int enable_usb_device_next(void)
{
	int err;

	err = usbd_add_descriptor(&sample_usbd, &sample_lang);
	if (err) {
		LOG_ERR("Failed to initialize language descriptor (%d)", err);
		return err;
	}

	err = usbd_add_descriptor(&sample_usbd, &sample_mfr);
	if (err) {
		LOG_ERR("Failed to initialize manufacturer descriptor (%d)", err);
		return err;
	}

	err = usbd_add_descriptor(&sample_usbd, &sample_product);
	if (err) {
		LOG_ERR("Failed to initialize product descriptor (%d)", err);
		return err;
	}

	err = usbd_add_descriptor(&sample_usbd, &sample_sn);
	if (err) {
		LOG_ERR("Failed to initialize SN descriptor (%d)", err);
		return err;
	}

	err = usbd_add_configuration(&sample_usbd, &config_1);
	if (err) {
		LOG_ERR("Failed to add configuration (%d)", err);
		return err;
	}

	err = usbd_register_class(&sample_usbd, "cdc_acm_0", 1);
	if (err) {
		LOG_ERR("Failed to register CDC ACM class (%d)", err);
		return err;
	}

	err = usbd_init(&sample_usbd);
	if (err) {
		LOG_ERR("Failed to initialize device support");
		return err;
	}

	err = usbd_enable(&sample_usbd);
	if (err) {
		LOG_ERR("Failed to enable device support");
		return err;
	}

	LOG_DBG("USB device support enabled");

	return 0;
}
#endif /* IS_ENABLED(CONFIG_USB_DEVICE_STACK_NEXT) */

static void interrupt_handler(const struct device *dev, void *user_data)
{
	ARG_UNUSED(user_data);

	while (uart_irq_update(dev) && uart_irq_is_pending(dev)) {
		if (uart_irq_rx_ready(dev)) {
			int recv_len, rb_len;
			uint8_t buffer[64];
			size_t len = MIN(ring_buf_space_get(&ringbuf),
					 sizeof(buffer));

			recv_len = uart_fifo_read(dev, buffer, len);
			if (recv_len < 0) {
				LOG_ERR("Failed to read UART FIFO");
				recv_len = 0;
			};

			rb_len = ring_buf_put(&ringbuf, buffer, recv_len);
			if (rb_len < recv_len) {
				LOG_ERR("Drop %u bytes", recv_len - rb_len);
			}

			LOG_DBG("tty fifo -> ringbuf %d bytes", rb_len);
			if (rb_len) {
				uart_irq_tx_enable(dev);
			}
		}

		if (uart_irq_tx_ready(dev)) {
			uint8_t buffer[64];
			int rb_len, send_len;

			rb_len = ring_buf_get(&ringbuf, buffer, sizeof(buffer));
			if (!rb_len) {
				LOG_DBG("Ring buffer empty, disable TX IRQ");
				uart_irq_tx_disable(dev);
				continue;
			}

			send_len = uart_fifo_fill(dev, buffer, rb_len);
			if (send_len < rb_len) {
				LOG_ERR("Drop %d bytes", rb_len - send_len);
			}

			LOG_DBG("ringbuf -> tty fifo %d bytes", send_len);
		}
	}
}

int usb_cdc_acm_thread(void* unused1, void* unused2, void* unused3)
{
	const struct device *dev;
	uint32_t baudrate, dtr = 0U;
	int ret;

	dev = DEVICE_DT_GET_ONE(zephyr_cdc_acm_uart);
	if (!device_is_ready(dev)) {
		LOG_ERR("CDC ACM device not ready");
		return 0;
	}

#if defined(CONFIG_USB_DEVICE_STACK_NEXT)
		ret = enable_usb_device_next();
#else
		ret = usb_enable(NULL);
#endif

	if (ret != 0) {
		LOG_ERR("Failed to enable USB");
		return 0;
	}

	ring_buf_init(&ringbuf, sizeof(ring_buffer), ring_buffer);

	LOG_INF("Wait for DTR");

	while (true) {
		uart_line_ctrl_get(dev, UART_LINE_CTRL_DTR, &dtr);
		if (dtr) {
			break;
		} else {
			/* Give CPU resources to low priority threads. */
			k_sleep(K_MSEC(100));
		}
	}

	LOG_INF("DTR set");

	/* They are optional, we use them to test the interrupt endpoint */
	ret = uart_line_ctrl_set(dev, UART_LINE_CTRL_DCD, 1);
	if (ret) {
		LOG_WRN("Failed to set DCD, ret code %d", ret);
	}

	ret = uart_line_ctrl_set(dev, UART_LINE_CTRL_DSR, 1);
	if (ret) {
		LOG_WRN("Failed to set DSR, ret code %d", ret);
	}

	/* Wait 100ms for the host to do all settings */
	k_msleep(100);

	ret = uart_line_ctrl_get(dev, UART_LINE_CTRL_BAUD_RATE, &baudrate);
	if (ret) {
		LOG_WRN("Failed to get baudrate, ret code %d", ret);
	} else {
		LOG_INF("Baudrate detected: %d", baudrate);
	}

	uart_irq_callback_set(dev, interrupt_handler);

	/* Enable rx interrupts */
	uart_irq_rx_enable(dev);
	return 0;
}

#endif /* CONFIG_APP_CDC_ACM_LOGGING */
```
