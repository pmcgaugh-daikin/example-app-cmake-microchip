## boards/arm/pic32cx_sg41_cultra/Kconfig.board
```kconfig
# PIC32CX SG41 Curiosity Ultra Board Kconfig

# Copyright (c) 2023 Daikin Comfort Technologies North America, Inc.
# Copyright (c) 2018 Bryan O'Donoghue
# SPDX-License-Identifier: Apache-2.0

config BOARD_PIC32CX_SG41_CULTRA
	bool "PIC32CX SG41 Curiosity Ultra"
	depends on SOC_PART_NUMBER_SAMD51N20A
```

## boards/arm/pic32cx_sg41_cultra/Kconfig.defconfig
```kconfig
# PIC32CX SG41 Curiosity Ultra Board Configuration

# Copyright (c) 2023 Daikin Comfort Technologies North America, Inc.
# Copyright (c) 2019 Benjamin Valentin
# SPDX-License-Identifier: Apache-2.0

if BOARD_PIC32CX_SG41_CULTRA

config BOARD
	default "pic32cx_sg41_cultra"
	depends on BOARD_PIC32CX_SG41_CULTRA

if ETH_SAM_GMAC

# Read MAC address from AT24MAC402 EEPROM

config ETH_SAM_GMAC_MAC_I2C_INT_ADDRESS
	default 0x9A

config ETH_SAM_GMAC_MAC_I2C_INT_ADDRESS_SIZE
	default 1

config ETH_SAM_GMAC_MAC_I2C_EEPROM
	default y
	select I2C

endif # ETH_SAM_GMAC

if NETWORKING

config NET_L2_ETHERNET
	default y

endif # NETWORKING

endif # BOARD_PIC32CX_SG41_CULTRA
```

## boards/arm/pic32cx_sg41_cultra/pic32cx_sg41_cultra_defconfig
```kconfig
# Copyright (c) 2023 Daikin Comfort Technologies North America, Inc.
# Copyright (c) 2019 Benjamin Valentin
# SPDX-License-Identifier: Apache-2.0
CONFIG_SOC_SERIES_SAMD51=y
CONFIG_SOC_PART_NUMBER_SAMD51N20A=y
BOARD_PIC32CX_SG41_CULTRA=y
CONFIG_BUILD_OUTPUT_HEX=y
CONFIG_ARM_MPU=y
CONFIG_SOC_ATMEL_SAMD5X_XOSC32K=y
CONFIG_SOC_ATMEL_SAMD5X_XOSC32K_AS_MAIN=y
CONFIG_CONSOLE=y
CONFIG_UART_CONSOLE=y
CONFIG_SERIAL=y
CONFIG_UART_INTERRUPT_DRIVEN=y
CONFIG_GPIO=y

# Enable HW stack protection
CONFIG_HW_STACK_PROTECTION=y
```

## tests/lib/custom_lib/testcase.yaml
```yaml
common:
  tags: extensibility
  integration_platforms:
    #- custom_plank
    #- qemu_cortex_m0
    - atsame54_xpro
tests:
  lib.custom_lib: {}
  lib.custom_lib.non_default:
    extra_args: CONFIG_CUSTOM_LIB_GET_VALUE_DEFAULT=6
```
